AUTOSAR XML (schema 00050)
package /ARRoot
  can cluster BlindSpotDetectionCanCluster
  ecu instance BlindSpotDetectionEcuInstance
    can communication controller BlindSpotDetectionCanCommunicationController
    can communication connector BlindSpotDetectionCanCommunicationConnector
  flat map BlindSpotDetectionFlatMap: instances=flat-instance-descriptor=BlindSpotDetectionSystem.BlindSpotDetection
  system BlindSpotDetectionSystem
    system mapping BlindSpotDetectionMapping: swc-to-impl-mapping=BlindSpotDetectionIMP, swc-to-ecu-mapping=component=BlindSpotDetectionComposition..
    root-software-compositions:
      root sw composition prototype BlindSpotDetectionComposition
  composition sw component type BlindspotDetectionSwCompositionType
  can cluster DefoggerCanCluster
  ecu instance DefoggerEcuInstance
    can communication controller DefoggerCanCommunicationController
    can communication connector DefoggerCanCommunicationConnector
  flat map DefoggerFlatMap: instances=flat-instance-descriptor=DefoggerSystem.Defogger
  composition sw component type DefoggerSwCompositionType
  system DefoggerSystem
    system mapping DefoggerMapping: swc-to-ecu-mapping=component=DefoggerComposition..
    root-software-compositions:
      root sw composition prototype DefoggerComposition
  can cluster DisplayCanCluster
  ecu instance DisplayEcuInstance
    can communication controller DisplayCanCommunicationController
    can communication connector DisplayCanCommunicationConnector
  flat map DisplayFlatMap: instances=flat-instance-descriptor=DisplaySystem.Display
  composition sw component type DisplaySwCompositionType
  system DisplaySystem
    system mapping DisplayMapping: swc-to-impl-mapping=DisplayIMP, swc-to-ecu-mapping=component=DisplayComposition..
    root-software-compositions:
      root sw composition prototype DisplayComposition
  can cluster SensorCanCluster
  ecu instance SensorEcuInstance
    can communication controller SensorCanCommunicationController
    can communication connector SensorCanCommunicationConnector
  flat map SensorFlatMap: instances=flat-instance-descriptor=SensorSystem.Sensor
  composition sw component type SensorSwCompositionType
  system SensorSystem
    system mapping SensorMapping: swc-to-ecu-mapping=component=SensorComposition..
    root-software-compositions:
      root sw composition prototype SensorComposition
  can cluster SideMirrorCanCluster
    can physical channel SideMirrorPhysicalChannel: comm-connectors=SideMirrorCanConnector
  ecu instance SideMirrorEcuInstance
    can communication controller SideMirrorCanCommunication
    can communication connector SideMirrorCanConnector: comm-controller=SideMirrorCanCommunication
  flat map SideMirrorFlatMap: instances=flat-instance-descriptor=SideMirrorSystem.SideMirrorSystem
  composition sw component type SideMirrorSwComponentType
  system SideMirrorSystem
    system mapping SideMirrorMapping: swc-to-ecu-mapping=component=SideMirrorComposition..
    root-software-compositions:
      root sw composition prototype SideMirrorComposition
